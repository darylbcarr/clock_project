## sdkconfig.defaults
```kconfig
# Clock Project SDK Configuration Defaults

# Enable C++ exceptions (needed for std::string formatting etc.)
CONFIG_COMPILER_CXX_EXCEPTIONS=y

# FreeRTOS tick rate
CONFIG_FREERTOS_HZ=1000

# Enable SNTP
CONFIG_LWIP_DHCP_GET_NTP_SRV=y

# ADC / GPIO
CONFIG_ADC_SUPPRESS_DEPRECATE_WARN=y

# Allow new and legacy I2C drivers to coexist (Display uses new driver,
# Encoder seesaw shares the same bus via new driver's bus handle)
CONFIG_I2C_SKIP_LEGACY_CONFLICT_CHECK=y

# Logging
CONFIG_LOG_DEFAULT_LEVEL_INFO=y

# ── Partition table ───────────────────────────────────────────────────────────
# Custom partition table with OTA (ota_0 / ota_1) and FAT storage.
# Two layouts are defined in partitions.csv — comment/uncomment as needed:
#   Production (16 MB flash):  active by default
#   Development (32 MB flash): swap the commented blocks in partitions.csv
CONFIG_PARTITION_TABLE_CUSTOM=y
CONFIG_PARTITION_TABLE_CUSTOM_FILENAME="partitions.csv"

# Flash size — must match the active layout in partitions.csv.
# Production device: 16 MB   → CONFIG_ESPTOOLPY_FLASHSIZE_16MB=y
# Development device: 32 MB  → change to CONFIG_ESPTOOLPY_FLASHSIZE_32MB=y
CONFIG_ESPTOOLPY_FLASHSIZE_16MB=y
CONFIG_ESPTOOLPY_FLASHSIZE="16MB"

# OTA support — required for ota_0/ota_1 partition scheme
CONFIG_BOOTLOADER_APP_ROLLBACK_ENABLE=n

# WebSocket support for the HTTP server
CONFIG_HTTPD_WS_SUPPORT=y

# ── IRAM reduction ───────────────────────────────────────────────────────────
# Matter + BLE pushes IRAM over the segment limit.  Moving WiFi ISR code and
# heap functions to flash recovers ~20+ KB IRAM with negligible impact on a
# low-throughput IoT device.
CONFIG_ESP_WIFI_IRAM_OPT=n
CONFIG_ESP_WIFI_RX_IRAM_OPT=n
CONFIG_HEAP_PLACE_FUNCTION_INTO_FLASH=y

# ── mbedTLS extras required by Matter ────────────────────────────────────────
# HKDF is used by CHIP crypto (CHIPCryptoPALmbedTLS) but disabled by default.
CONFIG_MBEDTLS_HKDF_C=y

# ── Matter / CHIP ─────────────────────────────────────────────────────────────
# Bluetooth for BLE commissioning (first-time pairing via Home app)
CONFIG_BT_ENABLED=y
CONFIG_BT_NIMBLE_ENABLED=y

# Matter data model
CONFIG_ESP_MATTER_ENABLE_DATA_MODEL=y

# Do NOT let Matter manage WiFi — this project's Networking component does it.
# Matter will use the existing WiFi connection for Matter-over-IP.
CONFIG_CHIP_ENABLE_WIFI_STATION=n

# Read PIN and discriminator from NVS ("fctry" partition, "chip-factory" namespace)
# instead of using the compile-time test constants (20202021 / 3840).
# This allows each device to advertise a unique discriminator derived from its
# MAC address, so multiple devices in the same home get distinct pairing codes.
# Requires that ensure_unique_discriminator() writes the keys before matter::start().
CONFIG_ENABLE_TEST_SETUP_PARAMS=y
# Point CHIP's factory namespace at the dedicated "fctry" NVS partition (not "nvs").
# ensure_unique_discriminator() writes chip-factory/discriminator there on first boot.
CONFIG_CHIP_FACTORY_NAMESPACE_PARTITION_LABEL="fctry"

# Disable Matter shell (saves flash; use UART console instead)
CONFIG_ENABLE_CHIP_SHELL=n

# Use test/development attestation credentials (no factory data flashing needed
# for development). Set to y and flash factory data for production devices.
CONFIG_CHIP_FACTORY_DATA=n
```
